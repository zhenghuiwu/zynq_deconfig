/*
 * CAUTION: This file is automatically generated by Xilinx.
 * Version:  
 * Today is: Thu Jul 18 16:22:56 2024
 */


/dts-v1/;
/include/ "zynq-7000.dtsi"
/include/ "pl.dtsi"
/include/ "pcw.dtsi"
/ {
	chosen {
		bootargs = "earlycon";
		stdout-path = "serial0:115200n8";
	};
	aliases {
		ethernet0 = &gem0;
		i2c0 = &i2c0;
		serial0 = &uart0;
		serial1 = &uart1;
		serial10 = &cam1_uartlite_3;
		serial11 = &cam2_uartlite_0;
		serial12 = &cam2_uartlite_1;
		serial13 = &cam2_uartlite_2;
		serial14 = &cam2_uartlite_3;
		serial15 = &cam3_uartlite_0;
		serial16 = &cam3_uartlite_1;
		serial17 = &cam3_uartlite_2;
		serial18 = &cam3_uartlite_3;
		serial19 = &axi_uartlite_1;
		serial2 = &axi_uartlite_0;
		serial3 = &cam0_uartlite_0;
		serial4 = &cam0_uartlite_1;
		serial5 = &cam0_uartlite_2;
		serial6 = &cam0_uartlite_3;
		serial7 = &cam1_uartlite_0;
		serial8 = &cam1_uartlite_1;
		serial9 = &cam1_uartlite_2;
		spi0 = &qspi;
	};
	memory {
		device_type = "memory";
		reg = <0x0 0x20000000>;
	};
};
